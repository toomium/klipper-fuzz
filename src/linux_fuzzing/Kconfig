## src/linux_fuzzing/Kconfig
```kconfig
# Kconfig settings for compiling and running the micro-controller code
# in a Linux process (Fuzzing Build)

if MACH_LINUX_FUZZING

config LINUX_FUZZING_SELECT
    bool
    default y
    select HAVE_GPIO
    select HAVE_GPIO_ADC
    select HAVE_GPIO_SPI
    select HAVE_GPIO_I2C
    select HAVE_GPIO_HARD_PWM

config BOARD_DIRECTORY
    string
    default "linux_fuzzing"

config CLOCK_FREQ
    int
    default 50000000

endif
```
